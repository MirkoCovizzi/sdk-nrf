## lib/at_parser/Kconfig
```kconfig
#
# Copyright (c) 2024 Nordic Semiconductor ASA
#
# SPDX-License-Identifier: LicenseRef-Nordic-5-Clause
#

config AT_PARSER
	bool "AT parser library"
	depends on NEWLIB_LIBC || EXTERNAL_LIBC || PICOLIBC
```

## lib/lte_link_control/modules/Kconfig
```kconfig
#
# Copyright (c) 2024 Nordic Semiconductor ASA
#
# SPDX-License-Identifier: LicenseRef-Nordic-5-Clause
#

config LTE_LC_CONEVAL
	bool ""
	default n

config LTE_LC_EDRX
	bool ""
	default n

config LTE_LC_NCELLMEAS
	bool ""
	default n

config LTE_LC_PERIODICSEARCHCONF
	bool ""
	default n

config LTE_LC_PSM
	bool ""
	default n

config LTE_LC_REDMOB
	bool ""
	default n

config LTE_LC_XFACTORYRESET
	bool ""
	default n

config LTE_LC_XMODEMSLEEP
	bool ""
	default n

config LTE_LC_XT3412
	bool ""
	default n
```

## tests/lib/at_parser/testcase.yaml
```yaml
tests:
  at_parser.at_parser:
    platform_allow: qemu_cortex_m3 native_posix
    integration_platforms:
      - qemu_cortex_m3
      - native_posix
    tags: at_parser
```
